/*
 *  This sketch sends data via HTTP GET requests to data.sparkfun.com service.
 *
 *  You need to get streamId and privateKey at data.sparkfun.com and paste them
 *  below. Or just customize this script to talk to other HTTP servers.
 *
 */

#include <stdio.h>
#include <ESP8266WiFi.h>
#include <IRsend.h>

#define PORT 30669

const char* ssid     = "__EDIT_ME__";
const char* password = "__EDIT_ME__";
const char* host = "__EDIT_ME__";

uint16_t on_18cmd[] = {
  9050, 4500, 600, 600, 550, 600, 600, 1700, 650, 550, 650, 1650,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 650
};

uint16_t on_19cmd[] = {
  9050, 4500, 600, 600, 550, 600, 550, 1700, 650, 550, 650, 1650,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 650
};

uint16_t on_20cmd[] = {
  9050, 4500, 600, 600, 650, 550, 650, 1650, 650, 550, 650, 1650,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 650
};

uint16_t on_21cmd[] = {
  9050, 4500, 600, 600, 550, 600, 600, 1700, 650, 550, 650, 1650,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 650
};

uint16_t on_22cmd[] = {
  9050, 4500, 600, 650, 550, 600, 600, 1700, 550, 600, 650, 1650,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 650
};

uint16_t on_23cmd[] = {
  9050, 4500, 600, 600, 550, 550, 600, 1700, 650, 550, 650, 1650,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 650
};

uint16_t on_24cmd[] = {
  9050, 4500, 600, 650, 600, 600, 600, 1700, 600, 600, 600, 1700,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 650
};

uint16_t on_25cmd[] = {
  9050, 4500, 600, 600, 550, 600, 600, 1700, 650, 550, 650, 1650,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 650
};

uint16_t on_26cmd[] = {
  9050, 4550, 600, 650, 550, 600, 600, 1700, 600, 600, 600, 1700,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 650
};

uint16_t off_cmd[] = {
  9050, 4500, 600, 600, 650, 550, 600, 1700, 650, 550, 600, 600,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 600
};

IRsend irsend1(2); // GPIO2
IRsend irsend2(3); // GPIO3 (Rx)

char buff[64];

// TODO: refactor this nonsense
void handle_cmd(String cmd) {
  if (cmd.equals("set ac1 temp 18")) {
    irsend1.sendRaw(on_18cmd, sizeof(on_18cmd) / sizeof(on_18cmd[0]), 38);
  } else if (cmd.equals("set ac1 temp 19")) {
    irsend1.sendRaw(on_19cmd, sizeof(on_19cmd) / sizeof(on_19cmd[0]), 38);
  } else if (cmd.equals("set ac1 temp 20")) {
    irsend1.sendRaw(on_20cmd, sizeof(on_20cmd) / sizeof(on_20cmd[0]), 38);
  } else if (cmd.equals("set ac1 temp 21")) {
    irsend1.sendRaw(on_21cmd, sizeof(on_21cmd) / sizeof(on_21cmd[0]), 38);
  } else if (cmd.equals("set ac1 temp 22")) {
    irsend1.sendRaw(on_22cmd, sizeof(on_22cmd) / sizeof(on_22cmd[0]), 38);
  } else if (cmd.equals("set ac1 temp 23")) {
    irsend1.sendRaw(on_23cmd, sizeof(on_23cmd) / sizeof(on_23cmd[0]), 38);
  } else if (cmd.equals("set ac1 temp 24")) {
    irsend1.sendRaw(on_24cmd, sizeof(on_24cmd) / sizeof(on_24cmd[0]), 38);
  } else if (cmd.equals("set ac1 temp 25")) {
    irsend1.sendRaw(on_25cmd, sizeof(on_25cmd) / sizeof(on_25cmd[0]), 38);
  } else if (cmd.equals("set ac1 temp 26")) {
    irsend1.sendRaw(on_26cmd, sizeof(on_26cmd) / sizeof(on_26cmd[0]), 38);
  } else if (cmd.equals("set ac1 off")) {
    irsend1.sendRaw( off_cmd, sizeof(off_cmd) / sizeof(off_cmd[0]), 38);
  } else if (cmd.equals("set ac2 temp 18")) {
    irsend2.sendRaw(on_18cmd, sizeof(on_18cmd) / sizeof(on_18cmd[0]), 38);
  } else if (cmd.equals("set ac2 temp 19")) {
    irsend2.sendRaw(on_19cmd, sizeof(on_19cmd) / sizeof(on_19cmd[0]), 38);
  } else if (cmd.equals("set ac2 temp 20")) {
    irsend2.sendRaw(on_20cmd, sizeof(on_20cmd) / sizeof(on_20cmd[0]), 38);
  } else if (cmd.equals("set ac2 temp 21")) {
    irsend2.sendRaw(on_21cmd, sizeof(on_21cmd) / sizeof(on_21cmd[0]), 38);
  } else if (cmd.equals("set ac2 temp 22")) {
    irsend2.sendRaw(on_22cmd, sizeof(on_22cmd) / sizeof(on_22cmd[0]), 38);
  } else if (cmd.equals("set ac2 temp 23")) {
    irsend2.sendRaw(on_23cmd, sizeof(on_23cmd) / sizeof(on_23cmd[0]), 38);
  } else if (cmd.equals("set ac2 temp 24")) {
    irsend2.sendRaw(on_24cmd, sizeof(on_24cmd) / sizeof(on_24cmd[0]), 38);
  } else if (cmd.equals("set ac2 temp 25")) {
    irsend2.sendRaw(on_25cmd, sizeof(on_25cmd) / sizeof(on_25cmd[0]), 38);
  } else if (cmd.equals("set ac2 temp 26")) {
    irsend2.sendRaw(on_26cmd, sizeof(on_26cmd) / sizeof(on_26cmd[0]), 38);
  } else if (cmd.equals("set ac2 off")) {
    irsend2.sendRaw( off_cmd, sizeof(off_cmd) / sizeof(off_cmd[0]), 38);
  } else if (cmd.equals("ping")) {
    Serial.println("Got ping");
  } else {
    Serial.println("Unknown command");
  }
}

void setup() {
  Serial.begin(115200);
  irsend1.begin();
  irsend2.begin();
  delay(10);

  Serial.println();
  Serial.print("Connecting to ");
  Serial.println(ssid);

  WiFi.begin(ssid, password);

  while (WiFi.status() != WL_CONNECTED) {
    delay(500);
    Serial.print(".");
  }

  Serial.println("");
  Serial.println("WiFi connected");
  Serial.println("IP address: ");
  Serial.println(WiFi.localIP());
}

void loop() {
  delay(1000);
  unsigned long lastRead = millis();

  if (WiFi.status() != WL_CONNECTED) {
    ESP.reset();
  }

  Serial.print("Connecting to ");
  Serial.println(host);

  // Use WiFiClient class to create TCP connections
  WiFiClient client;
  if (!client.connect(host, PORT)) {
    Serial.println("Connection failed. Will return loop().");
    return;
  }

  while(client.connected()) {
    while(client.available()){
      Serial.println("There is data available. Will begin reading until newline");
      String line = client.readStringUntil('\n');
      Serial.print("Got line: ");
      Serial.println(line);
      handle_cmd(line);
      client.println("Ok!");

      lastRead = millis();
    }

    if (millis() - lastRead > 15 * 1000) {
      Serial.println("Timeout. Resetting");
      ESP.reset();
    }
  }

  Serial.println("Client is disconnected");
}
